; *************************************************************
; *** Scatter-Loading Description File generated by uVision ***
; *************************************************************

LR_IROM1 0x08000000 0x00080000  {    ; load region size_region
  ER_IROM1 0x08000000 0x00080000  {  ; load address = execution address
   *.o (RESET, +First)
   *(InRoot$$Sections)
   .ANY (+RO)
   .ANY (+XO)
  }
  RW_IRAM1 0x20000000 0x00020000  {  ; RW data - DTCMRAM (128KB)
   .ANY (+RW +ZI)
  }
  RW_IRAM2 0x24000000 0x00080000  {  ; RAM D1 - AXI SRAM (512KB)
   *(.RAM_D1)
  }
  ;RW_IRAM3 0x30000000 0x00048000  {  ; RAM D2 - AHB SRAM 1~3 (288KB)
  ; *(.RAM_D2)
  ;}
  ;RW_IRAM4 0x38000000 0x00010000  {  ; RAM D3 - AHB SRAM Domain4 (64KB)
  ; *(.RAM_D3)
  ;}
  RW_IRAM5 0x00000080 0x00010000  {  ; RW data - ITCMRAM (64KB - 0x80)
    ; /* Board Group */
    board.o (+RO)
    bsp_api.o (+RO)
    ;drv_can_app.o (+RO)
    ;drv_encoder.o (+RO)
    system_timer.o (+RO)

    ; /* System Manage  Group */
    system_init.o (+RO)

    ; /* Motor Control Group */
    motor_ctl_loop.o (+RO)
    motor_ctl_sm.o (+RO)
    current_ctl_loop_task.o (+RO)
    ;database_init.o (+RO)
    ;direction_id.o (+RO)
    ;elec_angle_id.o (+RO)
    input_shaping_ei.o (+RO)
    linear_trajectory_planning.o (+RO)
    load_pos_sensor.o (+RO)
    math_lib.o (+RO)
    mit_ctl.o (+RO)
    motor_pos_sensor.o (+RO)
    notch_filter.o (+RO)
    notch_filter_config_set.o (+RO)
    ;pole_pairs_id.o (+RO)
    pos_speed_ctl_pip.o (+RO)
    pos_trajectory_planning.o (+RO)
    protect_check.o (+RO)
    reciprocal_motion.o (+RO)
    reference_signal.o (+RO)
    rt_urand_Upu32_Yd_f_pw.o (+RO)
    ;servo_hub_example.o (+RO)
    speed_obs_pll.o (+RO)
    sim_plant.o (+RO)
    ;tq_fc_id.o (+RO)
    csp_planning.o (+RO)
    cst_planning.o (+RO)
    csv_planning.o (+RO)

    ; /* App Group */
    app_scheduler.o (+RO)
    app_status_check.o (+RO)         ;To be restructured
    app_trajectory.o (+RO)
    app_motion_precondition.o (+RO)
    app_cyclic_sync_position_mode.o (+RO)
    app_cyclic_sync_torque_mode.o (+RO)
    app_cyclic_sync_velocity_mode.o (+RO)
    app_mit_mode.o (+RO)
    ;app_profile_position_mode.o (+RO)
    ;app_profile_torque_mode.o (+RO)
    ;app_profile_velocity_mode.o (+RO)
    ;app_homing_mode.o (+RO)
    scope_app.o (+RO)
    waveform_app.o (+RO)

    ; /* Communication Group */
    cia402_fsm.o (+RO)
    cia402_statusword.o (+RO)
    cia402_error_code.o (+RO)

    ; CANopen Zone

    ; EtherCAT Zone
    ecat_app_hw.o (+RO)
    ecat_drv_sqi.o (+RO)
    ecat_app.o (+RO)
    ;bootmode.o (+RO)
    ;coeappl.o (+RO)
    ecatappl.o (+RO)
    ;ecatcoe.o (+RO)
    ecateoe.o (+RO)
    ;ecatfoe.o (+RO)
    ecatslv.o (+RO)
    ;emcy.o (+RO)
    eoeappl.o (+RO)
    ;foeappl.o (+RO)
    mailbox.o (+RO)
    objdef.o (+RO)
    sdoserv.o (+RO)
    ; /* user Group */

  }
}

